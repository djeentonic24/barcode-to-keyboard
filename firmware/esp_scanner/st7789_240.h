#pragma once
// ST7789 240x240, 4-wire SPI, no CS, Mode 3 (M130T-240240-RGB-7).

#include <Arduino.h>
#include <SPI.h>

class St7789 {
 public:
  static const int16_t WIDTH = 240;
  static const int16_t HEIGHT = 240;

  St7789(int8_t sck, int8_t mosi, int8_t dc, int8_t rst, int8_t blk)
      : sck_(sck), mosi_(mosi), dc_(dc), rst_(rst), blk_(blk) {}

  void begin() {
    pinMode(dc_, OUTPUT);
    pinMode(rst_, OUTPUT);
    if (blk_ >= 0) {
      pinMode(blk_, OUTPUT);
      digitalWrite(blk_, LOW);
    }
    digitalWrite(dc_, HIGH);
    digitalWrite(rst_, LOW);
    delay(20);
    digitalWrite(rst_, HIGH);
    delay(150);

    SPI.begin(sck_, -1, mosi_, -1);

    cmd(0x01);
    delay(150);
    cmd(0x11);
    delay(120);
    cmd(0x3A);
    dat(0x55);
    cmd(0x36);
    dat(0x00);
    cmd(0x21);  // INVON
    cmd(0x13);
    cmd(0x29);
    delay(20);
    if (blk_ >= 0) {
      digitalWrite(blk_, HIGH);
    }
  }

  void fill(uint16_t color) { fillRect(0, 0, WIDTH, HEIGHT, color); }

  void fillRect(int16_t x, int16_t y, int16_t w, int16_t h, uint16_t color) {
    clip(x, y, w, h);
    if (w <= 0 || h <= 0) {
      return;
    }
    window(x, y, x + w - 1, y + h - 1);
    const uint32_t n = (uint32_t)w * (uint32_t)h;
    uint8_t pair[2] = {(uint8_t)(color >> 8), (uint8_t)color};
    uint8_t buf[256];
    for (int i = 0; i < 256; i += 2) {
      buf[i] = pair[0];
      buf[i + 1] = pair[1];
    }
    SPI.beginTransaction(spi_);
    digitalWrite(dc_, HIGH);
    uint32_t left = n;
    while (left) {
      uint32_t chunk = left > 128 ? 128 : left;
      SPI.writeBytes(buf, chunk * 2);
      left -= chunk;
    }
    SPI.endTransaction();
  }

  // 1-bit MSB-first bitmap, 1 = fg.
  void blitMono(int16_t x, int16_t y, int srcW, int srcH, int stride,
                const uint8_t *bits, int sx, int sy, uint16_t fg, uint16_t bg) {
    const int16_t dw = (int16_t)(srcW * sx);
    const int16_t dh = (int16_t)(srcH * sy);
    if (dw <= 0 || dh <= 0 || dw > WIDTH) {
      return;
    }
    window(x, y, x + dw - 1, y + dh - 1);
    const uint8_t fgh = (uint8_t)(fg >> 8), fgl = (uint8_t)fg;
    const uint8_t bgh = (uint8_t)(bg >> 8), bgl = (uint8_t)bg;
    uint8_t line[240 * 2];
    SPI.beginTransaction(spi_);
    digitalWrite(dc_, HIGH);
    for (int row = 0; row < srcH; ++row) {
      const uint8_t *src = bits + row * stride;
      int o = 0;
      for (int col = 0; col < srcW; ++col) {
        const bool on = src[col >> 3] & (0x80 >> (col & 7));
        const uint8_t hi = on ? fgh : bgh;
        const uint8_t lo = on ? fgl : bgl;
        for (int repX = 0; repX < sx; ++repX) {
          line[o++] = hi;
          line[o++] = lo;
        }
      }
      for (int repY = 0; repY < sy; ++repY) {
        SPI.writeBytes(line, (uint32_t)o);
      }
    }
    SPI.endTransaction();
  }

  void text5x7(int16_t x, int16_t y, const char *s, uint16_t fg, uint16_t bg) {
    while (*s) {
      glyph5x7(x, y, (uint8_t)*s++, fg, bg);
      x += 6;
    }
  }

 private:
  const SPISettings spi_{16000000, MSBFIRST, SPI_MODE3};
  int8_t sck_, mosi_, dc_, rst_, blk_;

  static void clip(int16_t &x, int16_t &y, int16_t &w, int16_t &h) {
    if (x < 0) {
      w += x;
      x = 0;
    }
    if (y < 0) {
      h += y;
      y = 0;
    }
    if (x + w > WIDTH) {
      w = WIDTH - x;
    }
    if (y + h > HEIGHT) {
      h = HEIGHT - y;
    }
  }

  void cmd(uint8_t v) {
    SPI.beginTransaction(spi_);
    digitalWrite(dc_, LOW);
    SPI.write(v);
    SPI.endTransaction();
  }

  void dat(uint8_t v) {
    SPI.beginTransaction(spi_);
    digitalWrite(dc_, HIGH);
    SPI.write(v);
    SPI.endTransaction();
  }

  void window(uint16_t x0, uint16_t y0, uint16_t x1, uint16_t y1) {
    cmd(0x2A);
    dat((uint8_t)(x0 >> 8));
    dat((uint8_t)x0);
    dat((uint8_t)(x1 >> 8));
    dat((uint8_t)x1);
    cmd(0x2B);
    dat((uint8_t)(y0 >> 8));
    dat((uint8_t)y0);
    dat((uint8_t)(y1 >> 8));
    dat((uint8_t)y1);
    cmd(0x2C);
  }

  void glyph5x7(int16_t x, int16_t y, uint8_t ch, uint16_t fg, uint16_t bg) {
    if (ch < 0x20 || ch > 0x7E) {
      ch = '?';
    }
    const uint8_t *g = kFont5x7[ch - 0x20];
    window(x, y, x + 5, y + 6);
    const uint8_t fgh = (uint8_t)(fg >> 8), fgl = (uint8_t)fg;
    const uint8_t bgh = (uint8_t)(bg >> 8), bgl = (uint8_t)bg;
    SPI.beginTransaction(spi_);
    digitalWrite(dc_, HIGH);
    for (int row = 0; row < 7; ++row) {
      for (int col = 0; col < 6; ++col) {
        bool on = false;
        if (col < 5) {
          on = g[col] & (1u << row);
        }
        SPI.write(on ? fgh : bgh);
        SPI.write(on ? fgl : bgl);
      }
    }
    SPI.endTransaction();
  }

  static const uint8_t kFont5x7[95][5];
};

const uint8_t St7789::kFont5x7[95][5] = {
    {0x00, 0x00, 0x00, 0x00, 0x00}, {0x00, 0x00, 0x5F, 0x00, 0x00},
    {0x00, 0x07, 0x00, 0x07, 0x00}, {0x14, 0x7F, 0x14, 0x7F, 0x14},
    {0x24, 0x2A, 0x7F, 0x2A, 0x12}, {0x23, 0x13, 0x08, 0x64, 0x62},
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    {0x08, 0x04, 0x08, 0x10, 0x08},
};
